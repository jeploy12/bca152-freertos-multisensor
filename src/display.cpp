#include <stdio.h>
#include "freertos/FreeRTOS.h"
#include "freertos/task.h"
#include "driver/i2c.h"
#include "rtos_objects.h"
#include "display.h"

static const uint8_t font[96][5] = {
{0x00,0x00,0x00,0x00,0x00},{0x00,0x00,0x5F,0x00,0x00},{0x00,0x07,0x00,0x07,0x00},{0x14,0x7F,0x14,0x7F,0x14},{0x24,0x2A,0x7F,0x2A,0x12},{0x23,0x13,0x08,0x64,0x62},{0x36,0x49,0x55,0x22,0x50},{0x00,0x05,0x03,0x00,0x00},{0x00,0x1C,0x22,0x41,0x00},{0x00,0x41,0x22,0x1C,0x00},{0x14,0x08,0x3E,0x08,0x14},{0x08,0x08,0x3E,0x08,0x08},{0x00,0x50,0x30,0x00,0x00},{0x08,0x08,0x08,0x08,0x08},{0x00,0x60,0x60,0x00,0x00},{0x20,0x10,0x08,0x04,0x02},
{0x3E,0x51,0x49,0x45,0x3E},{0x00,0x42,0x7F,0x40,0x00},{0x42,0x61,0x51,0x49,0x46},{0x21,0x41,0x45,0x4B,0x31},{0x18,0x14,0x12,0x7F,0x10},{0x27,0x45,0x45,0x45,0x39},{0x3C,0x4A,0x49,0x49,0x30},{0x01,0x71,0x09,0x05,0x03},{0x36,0x49,0x49,0x49,0x36},{0x06,0x49,0x49,0x29,0x1E},{0x00,0x36,0x36,0x00,0x00},{0x00,0x56,0x36,0x00,0x00},{0x08,0x14,0x22,0x41,0x00},{0x14,0x14,0x14,0x14,0x14},{0x00,0x41,0x22,0x14,0x08},{0x02,0x01,0x51,0x09,0x06},
{0x32,0x49,0x79,0x41,0x3E},{0x7E,0x11,0x11,0x11,0x7E},{0x7F,0x49,0x49,0x49,0x36},{0x3E,0x41,0x41,0x41,0x22},{0x7F,0x41,0x41,0x22,0x1C},{0x7F,0x49,0x49,0x49,0x41},{0x7F,0x09,0x09,0x09,0x01},{0x3E,0x41,0x49,0x49,0x7A},{0x7F,0x08,0x08,0x08,0x7F},{0x00,0x41,0x7F,0x41,0x00},{0x20,0x40,0x41,0x3F,0x01},{0x7F,0x08,0x14,0x22,0x41},{0x7F,0x40,0x40,0x40,0x40},{0x7F,0x02,0x0C,0x02,0x7F},{0x7F,0x04,0x08,0x10,0x7F},{0x3E,0x41,0x41,0x41,0x3E},
{0x7F,0x09,0x09,0x09,0x06},{0x3E,0x41,0x51,0x21,0x5E},{0x7F,0x09,0x19,0x29,0x46},{0x46,0x49,0x49,0x49,0x31},{0x01,0x01,0x7F,0x01,0x01},{0x3F,0x40,0x40,0x40,0x3F},{0x1F,0x20,0x40,0x20,0x1F},{0x3F,0x40,0x38,0x40,0x3F},{0x63,0x14,0x08,0x14,0x63},{0x07,0x08,0x70,0x08,0x07},{0x61,0x51,0x49,0x45,0x43},{0x00,0x7F,0x41,0x41,0x00},{0x02,0x04,0x08,0x10,0x20},{0x00,0x41,0x41,0x7F,0x00},{0x04,0x02,0x01,0x02,0x04},{0x40,0x40,0x40,0x40,0x40},
{0x00,0x01,0x02,0x04,0x00},{0x20,0x54,0x54,0x54,0x78},{0x7F,0x48,0x44,0x44,0x38},{0x38,0x44,0x44,0x44,0x20},{0x38,0x44,0x44,0x48,0x7F},{0x38,0x54,0x54,0x54,0x18},{0x08,0x7E,0x09,0x01,0x02},{0x08,0x14,0x54,0x54,0x3C},{0x7F,0x08,0x04,0x04,0x78},{0x00,0x44,0x7D,0x40,0x00},{0x20,0x40,0x44,0x3D,0x00},{0x7F,0x10,0x28,0x44,0x00},{0x00,0x41,0x7F,0x40,0x00},{0x7C,0x04,0x18,0x04,0x78},{0x7C,0x08,0x04,0x04,0x78},{0x38,0x44,0x44,0x44,0x38},
{0x7C,0x14,0x14,0x14,0x08},{0x08,0x14,0x14,0x18,0x7C},{0x7C,0x08,0x04,0x04,0x08},{0x48,0x54,0x54,0x54,0x20},{0x04,0x3F,0x44,0x40,0x20},{0x3C,0x40,0x40,0x20,0x7C},{0x1C,0x20,0x40,0x20,0x1C},{0x3C,0x40,0x30,0x40,0x3C},{0x44,0x28,0x10,0x28,0x44},{0x0C,0x50,0x50,0x50,0x3C},{0x44,0x64,0x54,0x4C,0x44},{0x00,0x08,0x36,0x41,0x00},{0x00,0x00,0x7F,0x00,0x00},{0x00,0x41,0x36,0x08,0x00},{0x10,0x08,0x08,0x10,0x08},{0x78,0x46,0x41,0x46,0x78}
};

static void oled_cmd(uint8_t cmd) {
    uint8_t data[2] = {0x00, cmd};
    i2c_master_write_to_device(I2C_MASTER_NUM, OLED_ADDR, data, 2, pdMS_TO_TICKS(100));
}

static void oled_data(uint8_t data) {
    uint8_t payload[2] = {0x40, data};
    i2c_master_write_to_device(I2C_MASTER_NUM, OLED_ADDR, payload, 2, pdMS_TO_TICKS(100));
}

void display_init(void) {
    i2c_config_t conf = {}; // Zero-initialize first
    conf.mode = I2C_MODE_MASTER;
    conf.sda_io_num = GPIO_NUM_21;
    conf.scl_io_num = GPIO_NUM_22;
    conf.sda_pullup_en = GPIO_PULLUP_ENABLE;
    conf.scl_pullup_en = GPIO_PULLUP_ENABLE;
    conf.master.clk_speed = 400000;
    i2c_param_config(I2C_NUM_0, &conf);
    i2c_driver_install(I2C_MASTER_NUM, conf.mode, 0, 0, 0);

    uint8_t cmds[] = {0xAE, 0x20, 0x02, 0xA1, 0xC8, 0x8D, 0x14, 0xAF};
    for (int i = 0; i < sizeof(cmds); i++) oled_cmd(cmds[i]);
}

static void oled_set_power(bool on) {
    oled_cmd(on ? 0xAF : 0xAE);
}

static void oled_set_cursor(uint8_t col, uint8_t page) {
    oled_cmd(0xB0 | page);
    oled_cmd(0x00 | (col & 0x0F));
    oled_cmd(0x10 | ((col >> 4) & 0x0F));
}

static void oled_clear(void) {
    for (int p = 0; p < 8; p++) {
        oled_set_cursor(0, p);
        for (int c = 0; c < 128; c++) oled_data(0x00);
    }
}

static void oled_print(uint8_t col, uint8_t page, const char *str) {
    oled_set_cursor(col, page);
    while (*str) {
        int idx = *str - 32;
        if (idx >= 0 && idx < 96) {
            for (int i = 0; i < 5; i++) oled_data(font[idx][i]);
            oled_data(0x00);
        }
        str++;
    }
}

void display_task(void *pvParameters) {
    SensorData data;
    char buffer[32];
    bool panel_on = true;
    bool drew_first_frame = false;

    for (;;) {
        EventBits_t bits = xEventGroupGetBits(system_event_group);
        bool is_active = (bits & EVENT_ACTIVE_BIT) != 0;

        // FR-10: "OLED enabled" is an ACTIVE-only behaviour. In INACTIVE the panel
        // is actually powered down (0xAE) and NO further I2C traffic is generated,
        // instead of redrawing a message every second.
        if (!is_active) {
            if (panel_on) {
                oled_clear();
                oled_set_power(false);
                panel_on = false;
                safe_log("[DisplayTask] OLED blanked for INACTIVE.");
            }
            vTaskDelay(pdMS_TO_TICKS(500));
            continue;
        }

        if (!panel_on) {
            oled_set_power(true);
            panel_on = true;
            safe_log("[DisplayTask] OLED re-enabled by motion.");
        }

        // Peek the shared snapshot WITHOUT consuming EVENT_DATA_BIT. The display
        // is the lowest-priority task and polls faster than the alarm waits, so
        // consuming the notification here would starve the alarm of samples.
        bool have_data = read_latest_snapshot(&data);

        if (have_data || !drew_first_frame) {
            oled_clear();

            if (have_data) {
                oled_print(0, 0, "=== ROOM MONITOR ===");

                switch (current_display_mode) {
                    case MODE_TEMP:
                        sprintf(buffer, "Temp: %.1f C", data.temperature);
                        break;
                    case MODE_HUMIDITY:
                        sprintf(buffer, "Hum:  %.1f %%", data.humidity);
                        break;
                    case MODE_LIGHT:
                        sprintf(buffer, "LDR:  %d %%", data.light_percent);
                        break;
                    case MODE_MOTION:
                        sprintf(buffer, "Motion: %s", data.motion_detected ? "YES" : "NO");
                        break;
                    default:
                        sprintf(buffer, "Mode Error");
                        break;
                }
                oled_print(0, 3, buffer);

                // Single source of truth: AlarmTask owns the threshold decision
                // and publishes EVENT_ALARM_BIT. Re-deriving the limits here
                // duplicated that logic and could disagree with the buzzer.
                // Reading the bit also inherits AlarmTask's INACTIVE gate.
                if (bits & EVENT_ALARM_BIT) {
                    oled_print(0, 6, "! ALARM ACTIVE !");
                } else {
                    oled_print(0, 6, " Status: NORMAL");
                }
            } else {
                // No telemetry yet: light the panel and show a placeholder
                // instead of a blank screen.
                oled_print(0, 0, "=== ROOM MONITOR ===");
                oled_print(0, 3, "Waiting for sensor...");
            }

            drew_first_frame = true;
        }

        vTaskDelay(pdMS_TO_TICKS(300));
    }
}
